;**********************************************************************************************
;											MACROS
;**********************************************************************************************
LoadNACKcounter MACRO

	  			MOVLW	D'0'
	  			MOVWF	Nack_Counter
	  			
	  			ENDM
;----------------------------------------------------------------------------------------------	
_SDA_HIGH		macro
				BSF		_SDA_IO			;_SDA-input,_SDA line is high from pull up
				endm
;----------------------------------------------------------------------------------------------
_SCL_HIGH		macro
				BSF		_SCL_IO			;_SCL-input,_SCL line is high from pull up
				endm
;----------------------------------------------------------------------------------------------
_SDA_LOW		macro
				BCF		_SDA			;
				BCF		_SDA_IO			;Put '0' on _SDA line
				endm
;----------------------------------------------------------------------------------------------
_SCL_LOW		macro
				BCF		_SCL			;
				BCF		_SCL_IO			;Put '0' on _SDA line
				endm
;----------------------------------------------------------------------------------------------

